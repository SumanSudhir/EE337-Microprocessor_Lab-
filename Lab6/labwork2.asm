; THIS SUBROUTINE WRITES CHARACTERS ON THE LCD
LCD_DATA EQU P2    ;LCD DATA PORT
LCD_RS   EQU P0.0  ;LCD REGISTER SELECT
LCD_RW   EQU P0.1  ;LCD READ/WRITE
LCD_EN   EQU P0.2  ;LCD ENABLE

ORG 0000H
LJMP MAIN

ORG 003BH
	LJMP ISR
	
ORG 200H
START:
      MOV P2,#00H
      ACALL DELAY
	  ACALL DELAY
	  ACALL LCD_INIT      ;INITIALISE LCD
	
	  ACALL DELAY
	  ACALL DELAY
	  ACALL DELAY
	
	  MOV A,#080H		 
	  ACALL LCD_COMMAND
	  ACALL DELAY
	  MOV   R0,#50H
	  ACALL LCD_SENDSTRING_FROM_RAM
	  LCALL DELAY2
	  LCALL DELAY2
	  LCALL DELAY2
	  LCALL DELAY2
	  LCALL DELAY2
	  LCALL DELAY2
	  LCALL DELAY2
	  LCALL DELAY2
	  LCALL DELAY2
	  LCALL DELAY2
RET		


START2:
      USING 0 
		  PUSH AR7
	  MOV P2,#00H
	  
     ; MOV P1,#00H
	  ;INITIAL DELAY FOR LCD POWER UP

	;HERE1:SETB P1.0
      	  ACALL DELAY
	;CLR P1.0
	  ACALL DELAY
	;SJMP HERE1

      MOV A,R0
	  SUBB A,#60H
	  ADD A,#80H
	  MOV R7,A
	  ACALL LCD_INIT      ;INITIALISE LCD
	
	  ACALL DELAY
	  ACALL DELAY
	  ACALL DELAY
	 

	  MOV A,R7	  ;PUT CURSOR ON SECOND ROW,3 COLUMN
	  ACALL LCD_COMMAND
	  ACALL DELAY
	  MOV   R0,#60H
	  ACALL LCD_SENDSTRING_FROM_RAM2
POP AR7
	RET			//STAY HERE 

;------------------------LCD INITIALISATION ROUTINE----------------------------------------------------
LCD_INIT:
         MOV   LCD_DATA,#38H  ;FUNCTION SET: 2 LINE, 8-BIT, 5X7 DOTS
         CLR   LCD_RS         ;SELECTED COMMAND REGISTER
         CLR   LCD_RW         ;WE ARE WRITING IN INSTRUCTION REGISTER
         SETB  LCD_EN         ;ENABLE H->L
		 ACALL DELAY
         CLR   LCD_EN
	     ACALL DELAY

         MOV   LCD_DATA,#0CH  ;DISPLAY ON, CURSON OFF
         CLR   LCD_RS         ;SELECTED INSTRUCTION REGISTER
         CLR   LCD_RW         ;WE ARE WRITING IN INSTRUCTION REGISTER
         SETB  LCD_EN         ;ENABLE H->L
		 ACALL DELAY
         CLR   LCD_EN
         
		 ACALL DELAY
         MOV   LCD_DATA,#01H  ;CLEAR LCD
         CLR   LCD_RS         ;SELECTED COMMAND REGISTER
         CLR   LCD_RW         ;WE ARE WRITING IN INSTRUCTION REGISTER
         SETB  LCD_EN         ;ENABLE H->L
		 ACALL DELAY
         CLR   LCD_EN
         
		 ACALL DELAY

         MOV   LCD_DATA,#06H  ;ENTRY MODE, AUTO INCREMENT WITH NO SHIFT
         CLR   LCD_RS         ;SELECTED COMMAND REGISTER
         CLR   LCD_RW         ;WE ARE WRITING IN INSTRUCTION REGISTER
         SETB  LCD_EN         ;ENABLE H->L
		 ACALL DELAY
         CLR   LCD_EN

		 ACALL DELAY
         
         RET                  ;RETURN FROM ROUTINE

;-----------------------COMMAND SENDING ROUTINE-------------------------------------
 LCD_COMMAND:
         MOV   LCD_DATA,A     ;MOVE THE COMMAND TO LCD PORT
         CLR   LCD_RS         ;SELECTED COMMAND REGISTER
         CLR   LCD_RW         ;WE ARE WRITING IN INSTRUCTION REGISTER
         SETB  LCD_EN         ;ENABLE H->L
		 ACALL DELAY
         CLR   LCD_EN
		 ACALL DELAY
    
         RET  
;-----------------------DATA SENDING ROUTINE-------------------------------------		     
 LCD_SENDDATA:
         MOV   LCD_DATA,A     ;MOVE THE COMMAND TO LCD PORT
         SETB  LCD_RS         ;SELECTED DATA REGISTER
         CLR   LCD_RW         ;WE ARE WRITING
         SETB  LCD_EN         ;ENABLE H->L
		 ACALL DELAY
         CLR   LCD_EN
         ACALL DELAY
		 ACALL DELAY
         RET                  ;RETURN FROM BUSY ROUTINE


;----------------------------------------------------------------------------------------------
LCD_SENDSTRING_FROM_RAM:
PUSH 0E0H
	LCD_SENDSTRING_FROM_RAM_LOOP:
	 	 CLR   A                 ;CLEAR ACCUMULATOR FOR ANY PREVIOUS DATA
	         MOV  A,@R0         ;LOAD THE FIRST CHARACTER IN ACCUMULATOR
	         JZ    EXIT2              ;GO TO EXIT IF ZERO
	         ACALL LCD_SENDDATA		;SEND FIRST CHAR
			; LCALL DELAY2
	         INC   R0              ;INCREMENT DATA POINTER
	         SJMP  LCD_SENDSTRING_FROM_RAM_LOOP    ;JUMP BACK TO SEND THE NEXT CHARACTER
EXIT2:    POP 0E0H
         RET                     ;END OF ROUTINE
;---------------------------------------------------------------------------
LCD_SENDSTRING_FROM_RAM2:
PUSH 0E0H
	LCD_SENDSTRING_FROM_RAM_LOOP2:
	 	 CLR   A                 ;CLEAR ACCUMULATOR FOR ANY PREVIOUS DATA
	         MOV  A,@R0         ;LOAD THE FIRST CHARACTER IN ACCUMULATOR
	         JZ    EXIT2_2              ;GO TO EXIT IF ZERO
	         ACALL LCD_SENDDATA		;SEND FIRST CHAR
			 LCALL DELAY2
	         INC   R0              ;INCREMENT DATA POINTER
	         SJMP  LCD_SENDSTRING_FROM_RAM_LOOP2    ;JUMP BACK TO SEND THE NEXT CHARACTER
EXIT2_2:    POP 0E0H
         RET                     ;END OF ROUTINE		 

;----------------------DELAY ROUTINE-----------------------------------------------------
DELAY:	 PUSH 0
	 PUSH 1
         MOV R0,#1
LOOP2:	 MOV R1,#255
	 LOOP1:	 DJNZ R1, LOOP1
	 DJNZ R0, LOOP2
	 POP 1
	 POP 0 
	 RET
;-----------------------------------------------------------------
DELAY2:	 PUSH 0
	 PUSH 1
	 PUSH 2
	 MOV R2,#10
     LOOP5:    MOV R0,#50
LOOP4:	 MOV R1,#200
	 LOOP3:	 DJNZ R1, LOOP3
	 DJNZ R0, LOOP4
	 DJNZ R2,LOOP5
	 POP 2
	 POP 1
	 POP 0 
	 RET 
;----------------------------------------------------------------
DETECT:	
	USING 0
	PUSH AR0
	PUSH AR7
	PUSH AR2
	PUSH AR3
	PUSH AR4
	PUSH AR5
	PUSH AR6
	MOV R2,P1
	MOV R3,P1

	MOV A,R2
	ANL A,#0F0H

	ROW_0:
	    CJNE A,#70H , ROW_1
	    MOV R4,#00H
	    SJMP NEXT
	ROW_1:
	    CJNE A,#0B0H , ROW_2
	    MOV R4,#01H
	    SJMP NEXT
	ROW_2:
	    CJNE A,#0D0H , ROW_3
	    MOV R4,#02H
	    SJMP NEXT	
	ROW_3:
		CJNE A,#0E0H,DONE
	    MOV R4,#03H
	
    NEXT: 
	MOV P1,#0FH
	MOV A,P1
	ANL A,#0FH

	COLUMN_0:
	    CJNE A,#0EH , COLUMN_1
	    MOV R5,#00H
	    SJMP CHECK
	COLUMN_1:
	    CJNE A,#0DH , COLUMN_2
	    MOV R5,#01H
	    SJMP CHECK
	COLUMN_2:
	    CJNE A,#0BH , COLUMN_3
	    MOV R5,#02H
	    SJMP CHECK
	COLUMN_3:
		CJNE A,#07H,DONE
	    MOV R5,#03H
	  
	
    CHECK:	
	MOV B,#04
	MOV A,R4
	MUL AB

	ADD A,R5
	MOV R6,A
	
	MOV R7,A
	MOV A,#09H
	SUBB A,R7
	JC ALPHABET
	
	MOV A,R7
	ADD A,#30H
	MOV 5DH,#30H
	MOV 5EH,A
	MOV 5FH,#00H
	LCALL START
	SJMP DONE
	
	ALPHABET:
	MOV A,R7
	ADD A,#37H
	MOV 5DH,#30H     ;FOR WRITING 0
	MOV 5EH,A
	MOV 5FH,#00H
	LCALL START
     DONE:	
	POP AR6
	POP AR5
	POP AR4
	POP AR3
	POP AR2
	POP AR7
	POP AR0
RET

DELAY_10MS:
    USING 0
    PUSH AR4
    PUSH AR3
    MOV R4,#200
    BACK1:
        MOV R3,#50
    BACK :
        DJNZ R3, BACK
        DJNZ R4, BACK1
    POP AR3
    POP AR4	
	RET



ISR:
    USING 0
	PUSH AR2

	LCALL DELAY_10MS
	MOV R2,P1
	CJNE R2,#0F0H , GO
	POP AR2
	RETI
	GO: 
	LCALL DETECT
	MOV A,9EH     ;AFTER READING THIS FLAG OF INTERRUPT BECOME ZERO 
	LCALL LCD_INIT
	
	MOV P1,#0F0H	 
	POP AR2
	RETI
  
MAIN:
	MOV 50H,#4BH
	MOV 51H,#45H
	MOV 52H,#59H
	MOV 53H,#20H
	MOV 54H,#50H
	MOV 55H,#52H
	MOV 56H,#45H
	MOV 57H,#53H
	MOV 58H,#53H
	MOV 59H,#45H
	MOV 5AH,#44H
	MOV 5BH,#20H
	MOV 5CH,#3AH
	
MOV R0,#60H
MOV @R0,#41H
INC R0
MOV @R0,#42H
INC R0
MOV @R0,#43H
INC R0
MOV @R0,#44H
INC R0
MOV @R0,#45H
INC R0
MOV @R0,#46H
INC R0
MOV @R0,#47H
INC R0
MOV @R0,#48H
INC R0
MOV @R0,#49H
INC R0
MOV @R0,#4AH
INC R0
MOV @R0,#4BH
INC R0
MOV @R0,#4CH
INC R0
MOV @R0,#4DH
INC R0
MOV @R0,#4EH
INC R0
MOV @R0,#4FH
INC R0
MOV @R0,#50H
INC R0
MOV @R0,#0H

;------- KEYPAD CONFIGURATION------------
MOV P1,#0F0H		;MSB AS ROW, LSB AS COLUMN									
SETB IE.7

MOV A,0B1H		;IEN1, INTERRUPT ENABLE REGISTER
ORL A,#01		;CHANGING ONLY THE REQUIRED BIT, WITHOUT CHANGING THE OTHER BITS
MOV 0B1H,A			

MOV 9CH,#0FH		;KBLS (LEVEL SELECTOR), MSB AS ROW, LSB AS COLUMN
MOV 9DH,#0F0H		;KBE (KEYBOARD ENABLE) MSB AS INTERRUPT, LSB AS I/O


;FOR MORE INFORMATION ABOUT KBE, KBLS, KBF READ THE DATASHEET FROM PAGE NO. 84
;----------------------------------------
HERE:	
	MOV R0,#60H                        ;

	LCALL LCD_INIT	
	
	MOV P1,#0F0H
	
	LCALL START2    ;WILL KEEP DISPLAYING ABCD.....
	SJMP HERE
END