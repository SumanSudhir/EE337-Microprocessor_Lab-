LCD_DATA EQU P2    ;LCD DATA PORT
LCD_RS   EQU P0.0  ;LCD REGISTER SELECT
LCD_RW   EQU P0.1  ;LCD READ/WRITE
LCD_EN   EQU P0.2  ;LCD ENABLE
LCD_CLR 	EQU 001H
LED EQU P1
	
	
ORG 0000H
LJMP MAIN

/*ORG 000BH 							;ISR FOR TIMER 1
LJMP ISR_T0

ISR_T0:
	DJNZ R3,CONTINUE
	INC R1
	MOV R3,#4
  CONTINUE:
	CLR TR0
	LCALL TWOS_T0
	SETB TR0
	LJMP DISPLAY
RETI
	
	*/
	
ORG 200H
/*TWOS_T0:
		USING 0
		PUSH AR0
		;MOV R0,#51H         ;INDIRECT READ FROM MEMORY LOCATION 81H
		MOV A,@R0
		CPL A    			;COMPLEMENT OF A
		CLR C
		ADD A,#01    		;ADD 1 TO MAKE IT 2'S COMPLEMENT
		MOV TL0,A          
		INC R0              ;CARRY FLAG IS NOT AFFECTED BY INC
		MOV A,@R0
		CPL A               ;COMPLEMENT OF ANOTHER BYTE
		ADDC A,#00H         ;WILL ADD CARRY IF GENERATED FROM LOWER BYTE
		MOV TH0,A      
		POP AR0
RET

*/
;------------------------DELAY--------------------
DELAY_SMALL:
		 PUSH 0
		 PUSH 1
         MOV R0,#1
LOOP4:
		MOV R1,#255
	 LOOP3:
		DJNZ R1, LOOP3
		DJNZ R0, LOOP4
	 POP 1
	 POP 0
RET

;----------------------------------------DELAY_BIG-------------------

DELAY_BIG:
	USING 0
	PUSH AR1
	PUSH AR2
	PUSH AR3
	PUSH PSW

	MOV R3,A        ;WILL GIVE THE DELAY OF A*50 MILISECOND
LOOP:
	MOV R2,#200
	BACK1:
	MOV R1,#0FFH
	BACK :
	DJNZ R1, BACK
	DJNZ R2, BACK1
	DJNZ R3,LOOP

	POP PSW
	POP AR3
	POP AR2
	POP AR1
RET
;-----------------------------LCD_INIT------------------------
LCD_INIT:
;INITIALIZES THE LCD

		MOV   LCD_DATA,#38H  ;FUNCTION SET: 2 LINE, 8-BIT, 5X7 DOTS
        CLR   LCD_RS         ;SELECTED COMMAND REGISTER
        CLR   LCD_RW         ;WE ARE WRITING IN INSTRUCTION REGISTER
        SETB  LCD_EN         ;ENABLE H->L
		ACALL DELAY_SMALL
        CLR   LCD_EN
		ACALL DELAY_SMALL

        MOV   LCD_DATA,#0CH  ;DISPLAY ON, CURSON OFF
        CLR   LCD_RS         ;SELECTED INSTRUCTION REGISTER
        CLR   LCD_RW         ;WE ARE WRITING IN INSTRUCTION REGISTER
        SETB  LCD_EN         ;ENABLE H->L
		ACALL DELAY_SMALL
        CLR   LCD_EN

		ACALL DELAY_SMALL
        MOV   LCD_DATA,#01H  ;CLEAR LCD
        CLR   LCD_RS         ;SELECTED COMMAND REGISTER
        CLR   LCD_RW         ;WE ARE WRITING IN INSTRUCTION REGISTER
        SETB  LCD_EN         ;ENABLE H->L
		ACALL DELAY_SMALL
        CLR   LCD_EN
        ACALL DELAY_SMALL

        MOV   LCD_DATA,#06H  ;ENTRY MODE, AUTO INCREMENT WITH NO SHIFT
        CLR   LCD_RS         ;SELECTED COMMAND REGISTER
        CLR   LCD_RW         ;WE ARE WRITING IN INSTRUCTION REGISTER
        SETB  LCD_EN         ;ENABLE H->L
		ACALL DELAY_SMALL
        CLR   LCD_EN
		ACALL DELAY_SMALL

   RET                  ;RETURN FROM ROUTINE

;------------------------LCD_COMMAND----------------------
LCD_COMMAND:
         MOV   LCD_DATA,A     ;MOVE THE COMMAND TO LCD PORT
         CLR   LCD_RS         ;SELECTED COMMAND REGISTER
         CLR   LCD_RW         ;WE ARE WRITING IN INSTRUCTION REGISTER
         SETB  LCD_EN         ;ENABLE H->L
		 ACALL DELAY_SMALL
         CLR   LCD_EN
		 ACALL DELAY_SMALL
RET

;------------------------LCD_SENDDATA------------------
LCD_SENDDATA:
         MOV   LCD_DATA,A     ;MOVE THE COMMAND TO LCD PORT
         SETB  LCD_RS         ;SELECTED DATA REGISTER
         CLR   LCD_RW         ;WE ARE WRITING
         SETB  LCD_EN         ;ENABLE H->L
		 ACALL DELAY_SMALL
         CLR   LCD_EN
         ACALL DELAY_SMALL
		 ACALL DELAY_SMALL
RET
;------------------------------------MAIN-----------------------
MAIN:

	MOV 60H,#41H
	MOV 61H,#42H
	MOV 62H,#43H
	MOV 63H,#44H
	MOV 64H,#45H
	MOV 65H,#46H
	MOV 66H,#47H
	MOV 67H,#48H
	MOV 68H,#49H
	MOV 69H,#4AH
	MOV 6AH,#4BH
	MOV 6BH,#4CH
	MOV 6CH,#4DH
	MOV 6DH,#4EH
	MOV 6EH,#4FH
	MOV 6FH,#50H
	
	MOV R1,60H
	LCALL DELAY_SMALL
	LCALL LCD_INIT
	LCALL DELAY_SMALL
	
LED_LOOP:
	LCALL LCD_INIT
	MOV A,#80H
	LCALL LCD_COMMAND
	LCALL DELAY_SMALL
	MOV R2,#16
	MOV R1,60H
	DISPLAY:
		MOV A,R1
		LCALL DELAY_SMALL
		LCALL LCD_SENDDATA
		MOV A,#2
		LCALL DELAY_BIG
		INC R1
		DJNZ R2,DISPLAY
	LJMP LED_LOOP
HERE:SJMP HERE
END
