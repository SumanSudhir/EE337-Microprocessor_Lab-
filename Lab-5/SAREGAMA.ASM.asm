ORG 0
LJMP MAIN

ORG 001BH 							;ISR FOR TIMER 1
LJMP ISR_T1

ORG 000BH 							;ISR FOR TIMER 0
LJMP ISR_T0

ORG 30H
	
ISR_T1:
	CPL P0.3
	CLR TR1
	LCALL TWOS_T1               ;FREQUENCY
	SETB TR1
RETI

ISR_T0:
	DJNZ R2,CONTINUE
	CPL P0.7
	INC R1
	INC R1                    ;MONITOR WHICH FREQUENCY TO TAKE
	MOV R2,#40
CONTINUE:
	CLR TR0
	LCALL TWOS_T0               ;DELAY OF 1S
	SETB TR0
RETI

ORG 100H
TWOS_T1:
		USING 0
		PUSH  AR1
		;MOV R1,#81H         ;INDIRECT READ FROM MEMORY LOCATION 81H
		MOV A,@R1
		CPL A    			;COMPLEMENT OF A
		CLR C
		ADD A,#01    		;ADD 1 TO MAKE IT 2'S COMPLEMENT
		MOV TL1,A          
		INC R1              ;CARRY FLAG IS NOT AFFECTED BY INC
		MOV A,@R1
		CPL A               ;COMPLEMENT OF ANOTHER BYTE
		ADDC A,#00H         ;WILL ADD CARRY IF GENERATED FROM LOWER BYTE
		MOV TH1,A
		POP AR1
RET										;2'S COMPLEMENT OF THE 16BIT NO. IS NOW STORED IN T0
	
ORG 200H
TWOS_T0:
		PUSH AR0
		;MOV R0,#51H         ;INDIRECT READ FROM MEMORY LOCATION 81H
		MOV A,@R0
		CPL A    			;COMPLEMENT OF A
		CLR C
		ADD A,#01    		;ADD 1 TO MAKE IT 2'S COMPLEMENT
		MOV TL0,A          
		INC R0              ;CARRY FLAG IS NOT AFFECTED BY INC
		MOV A,@R0
		CPL A               ;COMPLEMENT OF ANOTHER BYTE
		ADDC A,#00H         ;WILL ADD CARRY IF GENERATED FROM LOWER BYTE
		MOV TH0,A      
		POP AR0
RET

ORG 300H
MAIN:
	CLR P1.3
	CLR P1.7
	MOV TMOD,#11H ;                   TIMER 0, MODE 1,TIMER 1, MODE 1
	MOV IE,#8AH 					 ;ENABLE TIMER 0&1 INTERRUPT
	
	MOV R0,#51H
	MOV @R0,#50H				;MAX N = 65,536   FFFFH
	INC R0						;SETTING N = 8334/2 = 4167  FOR GETTING DELAY = 1/240SEC
	MOV @R0,#0C3H
	
	;------------------------------
	MOV R1,#71H
	
	
	MOV @R1,#47H													;MAX N = 65,536   FFFFH
	INC R1						;SETTING N = 8334/2 = 4167  FOR GETTING DELAY = 1/240SEC
	MOV @R1,#10H
									
	INC R1
	MOV @R1,#78H															;MAX N = 65,536   FFFFH
	INC R1						;SETTING N = 8334/2 = 4167  FOR GETTING DELAY = 1/240SEC
	MOV @R1,#0EH
					
	INC R1
	MOV @R1,#05H												;MAX N = 65,536   FFFFH
	INC R1						;SETTING N = 8334/2 = 4167  FOR GETTING DELAY = 1/240SEC
	MOV @R1,#0DH 
	
	INC R1
	MOV @R1,#35H												;MAX N = 65,536   FFFFH
	INC R1						;SETTING N = 8334/2 = 4167  FOR GETTING DELAY = 1/240SEC
	MOV @R1,#0CH      
	
	INC R1
	MOV @R1,#0DAH												;MAX N = 65,536   FFFFH
	INC R1						;SETTING N = 8334/2 = 4167  FOR GETTING DELAY = 1/240SEC
	MOV @R1,#0AH        		
	
	INC R1
	MOV @R1,#0C4H											;MAX N = 65,536   FFFFH
	INC R1						;SETTING N = 8334/2 = 4167  FOR GETTING DELAY = 1/240SEC
	MOV @R1,#09H
	
	INC R1
	MOV @R1,#0AEH											;MAX N = 65,536   FFFFH
	INC R1						;SETTING N = 8334/2 = 4167  FOR GETTING DELAY = 1/240SEC
	MOV @R1,#08H
	
	
	;SAUPPER
	INC R1
	MOV @R1,#24H											;MAX N = 65,536   FFFFH
	INC R1						;SETTING N = 8334/2 = 4167  FOR GETTING DELAY = 1/240SEC
	MOV @R1,#08H
	
	
	;PAUSE
	INC R1
	MOV @R1,#0FFH											;MAX N = 65,536   FFFFH
	INC R1						;SETTING N = 8334/2 = 4167  FOR GETTING DELAY = 1/240SEC
	MOV @R1,#0FFH
	;---------------------------------------
	;SAUPPER
	INC R1
	MOV @R1,#24H											;MAX N = 65,536   FFFFH
	INC R1						;SETTING N = 8334/2 = 4167  FOR GETTING DELAY = 1/240SEC
	MOV @R1,#08H
	
	;NI
	INC R1
	MOV @R1,#0AEH											;MAX N = 65,536   FFFFH
	INC R1						;SETTING N = 8334/2 = 4167  FOR GETTING DELAY = 1/240SEC
	MOV @R1,#08H
	
	INC R1
	MOV @R1,#0C4H											;MAX N = 65,536   FFFFH
	INC R1						;SETTING N = 8334/2 = 4167  FOR GETTING DELAY = 1/240SEC
	MOV @R1,#09H
	
	INC R1
	MOV @R1,#0DAH												;MAX N = 65,536   FFFFH
	INC R1						;SETTING N = 8334/2 = 4167  FOR GETTING DELAY = 1/240SEC
	MOV @R1,#0AH        		
	
	INC R1
	MOV @R1,#35H												;MAX N = 65,536   FFFFH
	INC R1						;SETTING N = 8334/2 = 4167  FOR GETTING DELAY = 1/240SEC
	MOV @R1,#0CH      

	INC R1
	MOV @R1,#05H												;MAX N = 65,536   FFFFH
	INC R1						;SETTING N = 8334/2 = 4167  FOR GETTING DELAY = 1/240SEC
	MOV @R1,#0DH 
	
	INC R1
	MOV @R1,#78H															;MAX N = 65,536   FFFFH
	INC R1						;SETTING N = 8334/2 = 4167  FOR GETTING DELAY = 1/240SEC
	MOV @R1,#0EH
	
	INC R1
	MOV @R1,#47H													;MAX N = 65,536   FFFFH
	INC R1						;SETTING N = 8334/2 = 4167  FOR GETTING DELAY = 1/240SEC
	MOV @R1,#10H
;-----------------------
	
	MOV R1,#71H
	MOV R2,#40
	MOV R0,#51H
	LCALL TWOS_T0
	
TONE:
	LCALL TWOS_T1
	SETB TR1
	SETB TR0
	
HERE:SJMP HERE

END