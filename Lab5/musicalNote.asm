ORG 00H
LJMP MAIN

ORG 0BH
LJMP ISR0
	
ORG 1BH
LJMP ISR1


ISR0:
	DJNZ R6,CONTINUE
		ACALL HALF_CYCLE_0
	CONTINUE:
		ACALL T0LOAD
RETI

HALF_CYCLE_0: 
	MOV A,R7
	MOV R6,A
	CPL P1.7
RET	
		
ORG 100H
T1LOAD:
	CLR TR1
	
	;MOV R1,#84H
	MOV A,#00H
	CPL A
	CLR C
	ADD A,#01H
	MOV TL1,A
	
	;MOV R1,#83H
	MOV A,#0C2H
	CPL A
	ADDC A,#00H
	MOV TH1,A
	
	SETB TR1
RET



ORG 300H	
T0LOAD:
	CLR TR0
	
	;MOV R0,#41H
	MOV A,@R0
	CPL A
	CLR C
	ADD A,#01H
	MOV TL0,A
	
	DEC R0
	MOV A,@R0
	JZ PAUSE
	CPL A
	CLR C
	ADDC A,#00H
	MOV TH0,A
	

	SETB TR0
	INC R0
RET

PAUSE:
	CLR P1.7
	INC R0
RET


ISR1:
	DJNZ R4,CONTINUE1
		ACALL HALF_CYCLE_1
	CONTINUE1:
		ACALL T1LOAD
RETI

HALF_CYCLE_1: 
	INC R0
	INC R0
	LCALL T0LOAD
	MOV A,@R1
	MOV R4,A
	INC R1
RET	


MAIN:
	MOV R0,#40H
	MOV @R0,#07H
	INC R0
	MOV @R0,#0FFH
	
	MOV 40H,#007H
	MOV 41H,#0FFH
	MOV 42H,#07H
	MOV 43H,#10H
	MOV 44H,#06H
	MOV 45H,#20H
	MOV 46H,#05H
	MOV 47H,#40H
	MOV 48H,#00H
	MOV 49H,#0FFH
	MOV 4AH,#02H
	MOV 4BH,#0FFH
	MOV 4CH,#07H
	MOV 4DH,#0DDH
	MOV 4EH,#07H
	MOV 4FH,#0DFH
	
	
	MOV R7,#2
	MOV R6,#2

	;MOV R1,#83H
	;MOV @R1,#0C2H
	;INC R1
	;MOV @R1,#00H
	MOV R4,#27
	
	MOV R1,#81H
	MOV @R1,#27
	MOV R1,#82H
	MOV @R1,#14
	MOV R1,#83H
	MOV @R1,#27
	MOV R1,#84H
	MOV @R1,#14


	MOV IE,#8AH
	MOV TMOD,#11H
	
	MOV R0,#41H
	MOV R1,#81H
	LCALL T0LOAD
	LCALL T1LOAD
	
	LOOP: SJMP LOOP
END		
		
	

	

