LCD_DATA EQU P2    ;LCD DATA PORT
LCD_RS   EQU P0.0  ;LCD REGISTER SELECT
LCD_RW   EQU P0.1  ;LCD READ/WRITE
LCD_EN   EQU P0.2  ;LCD ENABLE
LCD_CLR 	EQU 001H

ORG 0000H
LED EQU P1
LJMP MAIN

ORG 200H
;------------------------DELAY--------------------
DELAY_SMALL:
		 PUSH 0
		 PUSH 1
         MOV R0,#1
LOOP4:
		MOV R1,#255
	 LOOP3:
		DJNZ R1, LOOP3
		DJNZ R0, LOOP4
	 POP 1
	 POP 0
RET

;----------------------------BIG DELAY-----------------
DELAY_BIG:
	USING 0
	PUSH AR1
	PUSH AR2
	PUSH AR3
	PUSH PSW

	MOV R3,A        ;WILL GIVE THE DELAY OF A*50 MILISECOND
LOOP:
	MOV R2,#200
	BACK1:
	MOV R1,#0FFH
	BACK :
	DJNZ R1, BACK
	DJNZ R2, BACK1
	DJNZ R3,LOOP

	POP PSW
	POP AR3
	POP AR2
	POP AR1
RET
;-----------------------------LCD_INIT------------------------
LCD_INIT:
;INITIALIZES THE LCD

		MOV   LCD_DATA,#38H  ;FUNCTION SET: 2 LINE, 8-BIT, 5X7 DOTS
        CLR   LCD_RS         ;SELECTED COMMAND REGISTER
        CLR   LCD_RW         ;WE ARE WRITING IN INSTRUCTION REGISTER
        SETB  LCD_EN         ;ENABLE H->L
		ACALL DELAY_SMALL
        CLR   LCD_EN
		ACALL DELAY_SMALL

        MOV   LCD_DATA,#0CH  ;DISPLAY ON, CURSON OFF
        CLR   LCD_RS         ;SELECTED INSTRUCTION REGISTER
        CLR   LCD_RW         ;WE ARE WRITING IN INSTRUCTION REGISTER
        SETB  LCD_EN         ;ENABLE H->L
		ACALL DELAY_SMALL
        CLR   LCD_EN

		ACALL DELAY_SMALL
        MOV   LCD_DATA,#01H  ;CLEAR LCD
        CLR   LCD_RS         ;SELECTED COMMAND REGISTER
        CLR   LCD_RW         ;WE ARE WRITING IN INSTRUCTION REGISTER
        SETB  LCD_EN         ;ENABLE H->L
		ACALL DELAY_SMALL
        CLR   LCD_EN
        ACALL DELAY_SMALL

        MOV   LCD_DATA,#06H  ;ENTRY MODE, AUTO INCREMENT WITH NO SHIFT
        CLR   LCD_RS         ;SELECTED COMMAND REGISTER
        CLR   LCD_RW         ;WE ARE WRITING IN INSTRUCTION REGISTER
        SETB  LCD_EN         ;ENABLE H->L
		ACALL DELAY_SMALL
        CLR   LCD_EN
		ACALL DELAY_SMALL

   RET                  ;RETURN FROM ROUTINE

;------------------------LCD_COMMAND----------------------
LCD_COMMAND:
         MOV   LCD_DATA,A     ;MOVE THE COMMAND TO LCD PORT
         CLR   LCD_RS         ;SELECTED COMMAND REGISTER
         CLR   LCD_RW         ;WE ARE WRITING IN INSTRUCTION REGISTER
         SETB  LCD_EN         ;ENABLE H->L
		 ACALL DELAY_SMALL
         CLR   LCD_EN
		 ACALL DELAY_SMALL
RET

;------------------------LCD_SENDDATA------------------
LCD_SENDDATA:
         MOV   LCD_DATA,A     ;MOVE THE COMMAND TO LCD PORT
         SETB  LCD_RS         ;SELECTED DATA REGISTER
         CLR   LCD_RW         ;WE ARE WRITING
         SETB  LCD_EN         ;ENABLE H->L
		 ACALL DELAY_SMALL
         CLR   LCD_EN
         ACALL DELAY_SMALL
		 ACALL DELAY_SMALL
RET
;------------------------------------PACK_NIBBLE-----------------------


READNIBBLE:
	MOV P1,#0FFH
	MOV A,#60
	LCALL DELAY_BIG

	MOV A,P1
	;ANL A,#0FH
	MOV @R0,A
	SWAP A
	MOV P1,A   ;WILL SHOW INPUT ON LED

	MOV A,#60
	LCALL DELAY_BIG   ;WAIT FOR 5 SEC

	CLR P1.7
	CLR P1.6
	CLR P1.5
	CLR P1.4

RET

PACKNIBBLE:
	MOV A, 4EH
	SWAP A
	ADD A, 4FH
RET

READVALUES:
	PUSH AR0
	PUSH AR1
	PUSH AR2
	MOV R1,51H
	MOV R2,50H
	STORE:
		MOV R0, #4EH
		LCALL READNIBBLE
		MOV R0, #4FH
		LCALL READNIBBLE
		LCALL PACKNIBBLE
		MOV @R1,A
		INC R1
		DJNZ R2,STORE

		POP AR0
		POP AR1
		POP AR2
RET
;---------------------------------------------
BIN2ASCII:
		PUSH 60H
		PUSH 61H
		;PUSH AR0

		MOV R0,#30H

		MOV 60H,A
		ANL A,#0FH
		SUBB A,#10
		MOV A,60H
		ANL A,#0FH
		JNC SKIP
		LCALL LOOP2
		SJMP SKIP2
SKIP:
		ANL A,#0FH
		LCALL LOOP1

SKIP2:
		MOV A,60H
		ANL A,#0F0H
		SWAP A
		MOV 61H,A
		CLR C
		SUBB A,#10
		MOV A,61H
		JNC SKIP3
		LCALL LOOP2
		SKIP3:LCALL LOOP1
		;POP AR0
		POP 61H
		POP 60H
RET
;SKIP3:LCALL LOOP1
LOOP1:
		ADD A,#37H
		MOV @R0,A
		INC R0
		CLR C
RET

LOOP2:
		ADD A,#30H
		MOV @R0,A
		INC R0
		CLR C
RET

;-----------------------------------------

DISPLAY_VALUES:

	PUSH 0
	PUSH ACC
	MOV P1,#0FFH
	MOV A, #60
	ACALL DELAY_BIG	;2SEC DELAY
	MOV A,P1		;CLEAR LEDS
	ANL A,#0FH
	MOV 32H,A

	CJNE A, 50H, DISPLAY_VALUES_NEXT	;CHECK FOR OUT-OF-RANGE
	DISPLAY_VALUES_NEXT:
		SUBB A,50H
		JNC DISPLAY_VALUES_CLEAR	;IF OUT-OF-RANGE
		MOV A,32H
		ADD A, 51H					;ELSE GET ADDRESS OF DATA
		MOV R0, A
		MOV A, @R0					;MOVE DATA TO ACCUMULATOR

		ACALL BIN2ASCII

		MOV A,31H
		ACALL DELAY_SMALL
		ACALL LCD_SENDDATA				;DISPLAY THE DATA

		ACALL DELAY_SMALL
		MOV A,30H
		ADD A,#1
		ACALL DELAY_SMALL
		ACALL LCD_SENDDATA

		JMP DISPLAY_VALUES_EXIT		;SKIP LCD CLEAR

	DISPLAY_VALUES_CLEAR:
		MOV A, #LCD_CLR		;CLEAR LCD
		ACALL LCD_COMMAND

	DISPLAY_VALUES_EXIT:
	POP ACC
	POP 0
RET


MAIN:


MOV SP,#0CFH;-----------------------INITIALIZE STACK POINTER
MOV 50H,#3;------------------------SET VALUE OF K
MOV 51H,#60H;------------------------ARRAY A START LOCATION
MOV 4FH,#00;------------------------CLEAR LOCATION 4FH
LCALL READVALUES



MOV 50H,#3;------------------------VALUE OF K
MOV 51H,#60H;------------------------ARRAY B START LOCATION
ACALL DELAY_SMALL
ACALL LCD_INIT
ACALL DELAY_SMALL
ACALL DELAY_SMALL

SHOW:
MOV A,#85H
ACALL DELAY_SMALL
ACALL LCD_COMMAND
ACALL DELAY_SMALL

LCALL DISPLAY_VALUES
MOV A,#40
LCALL DELAY_BIG
SJMP SHOW

HERE:SJMP HERE
END
