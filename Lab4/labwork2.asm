LCD_DATA EQU P2    ;LCD DATA PORT
LCD_RS   EQU P0.0  ;LCD REGISTER SELECT
LCD_RW   EQU P0.1  ;LCD READ/WRITE
LCD_EN   EQU P0.2  ;LCD ENABLE
LCD_CLR 	EQU 001H

ORG 0000H
LED EQU P1
LJMP MAIN

ORG 200H
;------------------------DELAY--------------------
DELAY_SMALL:
		 PUSH 0
		 PUSH 1
         MOV R0,#1
LOOP4:
		MOV R1,#255
	 LOOP3:
		DJNZ R1, LOOP3
		DJNZ R0, LOOP4
	 POP 1
	 POP 0
RET

;----------------------------BIG DELAY-----------------
DELAY_BIG:
	USING 0
	PUSH AR1
	PUSH AR2
	PUSH AR3
	PUSH PSW

	MOV R3,A        ;WILL GIVE THE DELAY OF A*50 MILISECOND
LOOP:
	MOV R2,#200
	BACK1:
	MOV R1,#0FFH
	BACK :
	DJNZ R1, BACK
	DJNZ R2, BACK1
	DJNZ R3,LOOP

	POP PSW
	POP AR3
	POP AR2
	POP AR1
RET
;-----------------------------LCD_INIT------------------------
LCD_INIT:
;INITIALIZES THE LCD

		MOV   LCD_DATA,#38H  ;FUNCTION SET: 2 LINE, 8-BIT, 5X7 DOTS
        CLR   LCD_RS         ;SELECTED COMMAND REGISTER
        CLR   LCD_RW         ;WE ARE WRITING IN INSTRUCTION REGISTER
        SETB  LCD_EN         ;ENABLE H->L
		ACALL DELAY_SMALL
        CLR   LCD_EN
		ACALL DELAY_SMALL

        MOV   LCD_DATA,#0CH  ;DISPLAY ON, CURSON OFF
        CLR   LCD_RS         ;SELECTED INSTRUCTION REGISTER
        CLR   LCD_RW         ;WE ARE WRITING IN INSTRUCTION REGISTER
        SETB  LCD_EN         ;ENABLE H->L
		ACALL DELAY_SMALL
        CLR   LCD_EN

		ACALL DELAY_SMALL
        MOV   LCD_DATA,#01H  ;CLEAR LCD
        CLR   LCD_RS         ;SELECTED COMMAND REGISTER
        CLR   LCD_RW         ;WE ARE WRITING IN INSTRUCTION REGISTER
        SETB  LCD_EN         ;ENABLE H->L
		ACALL DELAY_SMALL
        CLR   LCD_EN
        ACALL DELAY_SMALL

        MOV   LCD_DATA,#06H  ;ENTRY MODE, AUTO INCREMENT WITH NO SHIFT
        CLR   LCD_RS         ;SELECTED COMMAND REGISTER
        CLR   LCD_RW         ;WE ARE WRITING IN INSTRUCTION REGISTER
        SETB  LCD_EN         ;ENABLE H->L
		ACALL DELAY_SMALL
        CLR   LCD_EN
		ACALL DELAY_SMALL

   RET                  ;RETURN FROM ROUTINE

;------------------------LCD_COMMAND----------------------
LCD_COMMAND:
         MOV   LCD_DATA,A     ;MOVE THE COMMAND TO LCD PORT
         CLR   LCD_RS         ;SELECTED COMMAND REGISTER
         CLR   LCD_RW         ;WE ARE WRITING IN INSTRUCTION REGISTER
         SETB  LCD_EN         ;ENABLE H->L
		 ACALL DELAY_SMALL
         CLR   LCD_EN
		 ACALL DELAY_SMALL
RET

;------------------------LCD_SENDDATA------------------
LCD_SENDDATA:
         MOV   LCD_DATA,A     ;MOVE THE COMMAND TO LCD PORT
         SETB  LCD_RS         ;SELECTED DATA REGISTER
         CLR   LCD_RW         ;WE ARE WRITING
         SETB  LCD_EN         ;ENABLE H->L
		 ACALL DELAY_SMALL
         CLR   LCD_EN
         ACALL DELAY_SMALL
		 ACALL DELAY_SMALL
RET
;---------------------BIN2ASCII-------------------------
BIN2ASCII:
		PUSH 60H
		PUSH 61H
		PUSH AR0

		MOV R0,#30H

		MOV 60H,A
		ANL A,#0FH
		SUBB A,#10
		MOV A,60H
		ANL A,#0FH
		JNC SKIP
		LCALL LOOP2
		SJMP SKIP2
SKIP:
		ANL A,#0FH
		LCALL LOOP1

SKIP2:
		MOV A,60H
		ANL A,#0F0H
		SWAP A
		MOV 61H,A
		CLR C
		SUBB A,#10
		MOV A,61H
		JNC SKIP3
		LCALL LOOP2
		SKIP3:LCALL LOOP1
		POP AR0
		POP 61H
		POP 60H
RET
;SKIP3:LCALL LOOP1
LOOP1:
		ADD A,#37H
		MOV @R0,A
		INC R0
		CLR C
RET

LOOP2:
		ADD A,#30H
		MOV @R0,A
		INC R0
		CLR C
RET

;--------------------READNIBBLE--------------

READNIBBLE:
	
	MOV P1,#0FFH
	MOV A,#60
	LCALL DELAY_BIG

	MOV A,P1
	ANL A,#0FH
	MOV 40H,A
	SWAP A
	MOV P1,A   ;WILL SHOW INPUT ON LED

	MOV A,#60
	LCALL DELAY_BIG   ;WAIT FOR 5 SEC

	CLR P1.7
	CLR P1.6
	CLR P1.5
	CLR P1.4

RET


DISPLAY16:
	LCALL READNIBBLE
	MOV A,40H
	SWAP A					; SAVED ADDRESS OF STARTING POSITION

	MOV R0,A				;POINTER TO ADDRESS
	MOV R7,#00H				;COUNT
	
	MOV P2,#00H
	MOV P1,#00H             ;to stop led
	LCALL DELAY_SMALL
	
	PRINT_NEXT:
		MOV A,@R0			;R0 HAS ADDRESS TO BE PRINTED		
		;ANL A, #0F0H
		;SWAP A
		LCALL BIN2ASCII
		;ACALL BIN2ASCII

		MOV A,31H
		ACALL DELAY_SMALL
		ACALL LCD_SENDDATA				;DISPLAY THE DATA

		ACALL DELAY_SMALL
		MOV A,30H
		;ADD A,#1
		ACALL DELAY_SMALL
		ACALL LCD_SENDDATA
		
	
		;-------------------------------------------------
		MOV A,#32			;SPACEBAR		
		LCALL LCD_SENDDATA
		INC R0
		INC R7
		
		CJNE R7,#4, CONTINUE
		MOV A,#0C0H            ;MOVE TO NEXT LINE
		LCALL LCD_COMMAND
		LCALL DELAY_SMALL
		;MOV A, #'4'		

		CONTINUE: CJNE R7,#8,CONTINUE2	
		MOV A,#100
		LCALL DELAY_BIG
		MOV A,#80H                         ;MOVE TO FIRST IF R7 = 8
		LCALL LCD_COMMAND

		CONTINUE2: CJNE R7,#12, CONTINUE3
		MOV A,#0C0H                           ;2ND LINE
		LCALL LCD_COMMAND
		LCALL DELAY_SMALL

		CONTINUE3: CJNE R7,#16,PRINT_NEXT     
		MOV A,#100
		LCALL DELAY_BIG
		LCALL DELAY_SMALL
		MOV A,#01H            ;CLR LCD
		LCALL LCD_COMMAND
		MOV A,#80H            ;MOVE TO 1ST LINE
		LCALL LCD_COMMAND      ;
		MOV A, #20
		LCALL DELAY_BIG
		
		SJMP DISPLAY16
		
RET

MAIN:
	MOV P2,#00H
	MOV P1,#00H
	LCALL DELAY_SMALL
	LCALL LCD_INIT
	lcall DELAY_SMALL
	MOV A,#80H
	LCALL LCD_COMMAND

	LCALL DELAY_SMALL
	
	MOV 70H,#0C3H
	MOV 71H,#0CCH
	MOV 72H,#0C2H
	MOV 73H,#0C3H
	MOV 74H,#0C4H
	MOV 75H,#0C5H
	MOV 76H,#0C6H
	MOV 77H,#0C7H
	MOV 78H,#0D8H
	MOV 79H,#0D9H
	MOV 7AH,#0DCH
	MOV 7BH,#0DBH
	MOV 7CH,#0DCH
	MOV 7DH,#0DDH
	MOV 7EH,#0DEH
	MOV 7FH,#0DFH
	
	MOV 60H,#0C2H
	MOV 61H,#0C4H
	MOV 62H,#0C6H
	MOV 63H,#0C3H
	MOV 64H,#0C4H
	MOV 65H,#0C5H
	MOV 66H,#0C6H
	MOV 67H,#0C7H
	MOV 68H,#0D8H
	MOV 69H,#0D9H
	MOV 6AH,#0DCH
	MOV 6BH,#0DBH
	MOV 6CH,#0DCH
	MOV 6DH,#0DDH
	MOV 6EH,#0DEH
	MOV 6FH,#0DFH
	
	LCALL DISPLAY16
	
END	

